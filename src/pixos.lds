/* Linker script for pixos */
INCLUDE app/app.lds

SECTIONS
{
    .vector ORIGIN(FLASH) :
    {
        KEEP(*(.vector.msp))
        KEEP(*(.vector.exception))
        KEEP(*(.vector.interrupt))
    } > FLASH

    .pixos.init :
    {
        . = ALIGN(4);
        __pixos_init_start = .;
        KEEP(*(.pixos.init.0))
        KEEP(*(.pixos.init.1))
        KEEP(*(.pixos.init.2))
        KEEP(*(.pixos.init.3))
        KEEP(*(.pixos.init.4))
        KEEP(*(.pixos.init.5))
        KEEP(*(.pixos.init.6))
        KEEP(*(.pixos.init.7))
        __pixos_init_end = .;
    } > FLASH

    .rodata :
    {
        . = ALIGN(4);
        *(.rodata*)
        . = ALIGN(4);
    } > FLASH

    .text :
    {
        . = ALIGN(4);
        *(.text*)
        . = ALIGN(4);
    } > FLASH

    .stack ORIGIN(RAM) :
    {
        KEEP(*(.stack))
        . = ALIGN(8);
        _estack = .;
    } > RAM

    .data :
    {
        . = ALIGN(4);
        _sdata = .;
        *(.data*)
        . = ALIGN(4);
        _edata = .;
    } > RAM
    _ldata = LOADADDR(.data);

    .bss :
    {
        . = ALIGN(4);
        _sbss = .;
        *(.bss*)
        . = ALIGN(4);
        _ebss = .;
    } > RAM AT > FLASH

    . = ALIGN(4);
    _sheap = .;
    _eheap = ORIGIN(RAM) + LENGTH(RAM);
}

EXTERN(EmptyISR);
EXTERN(BlockISR);
PROVIDE(Reset = EmptyISR);
PROVIDE(NonMaskableInt = EmptyISR);
PROVIDE(HardFault = BlockISR);
PROVIDE(MemoryManagement = BlockISR);
PROVIDE(BusFault = BlockISR);
PROVIDE(UsageFault = BlockISR);
PROVIDE(SVCall = EmptyISR);
PROVIDE(DebugMonitor = EmptyISR);
PROVIDE(PendSV = EmptyISR);
PROVIDE(SysTick = EmptyISR);
PROVIDE(ISR0 = EmptyISR);
PROVIDE(ISR1 = EmptyISR);
PROVIDE(ISR2 = EmptyISR);
PROVIDE(ISR3 = EmptyISR);
PROVIDE(ISR4 = EmptyISR);
PROVIDE(ISR5 = EmptyISR);
PROVIDE(ISR6 = EmptyISR);
PROVIDE(ISR7 = EmptyISR);
PROVIDE(ISR8 = EmptyISR);
PROVIDE(ISR9 = EmptyISR);
PROVIDE(ISR10 = EmptyISR);
PROVIDE(ISR11 = EmptyISR);
PROVIDE(ISR12 = EmptyISR);
PROVIDE(ISR13 = EmptyISR);
PROVIDE(ISR14 = EmptyISR);
PROVIDE(ISR15 = EmptyISR);
PROVIDE(ISR16 = EmptyISR);
PROVIDE(ISR17 = EmptyISR);
PROVIDE(ISR18 = EmptyISR);
PROVIDE(ISR19 = EmptyISR);
PROVIDE(ISR20 = EmptyISR);
PROVIDE(ISR21 = EmptyISR);
PROVIDE(ISR22 = EmptyISR);
PROVIDE(ISR23 = EmptyISR);
PROVIDE(ISR24 = EmptyISR);
PROVIDE(ISR25 = EmptyISR);
PROVIDE(ISR26 = EmptyISR);
PROVIDE(ISR27 = EmptyISR);
PROVIDE(ISR28 = EmptyISR);
PROVIDE(ISR29 = EmptyISR);
PROVIDE(ISR30 = EmptyISR);
PROVIDE(ISR31 = EmptyISR);
PROVIDE(ISR32 = EmptyISR);
PROVIDE(ISR33 = EmptyISR);
PROVIDE(ISR34 = EmptyISR);
PROVIDE(ISR35 = EmptyISR);
PROVIDE(ISR36 = EmptyISR);
PROVIDE(ISR37 = EmptyISR);
PROVIDE(ISR38 = EmptyISR);
PROVIDE(ISR39 = EmptyISR);
PROVIDE(ISR40 = EmptyISR);
PROVIDE(ISR41 = EmptyISR);
PROVIDE(ISR42 = EmptyISR);
PROVIDE(ISR43 = EmptyISR);
PROVIDE(ISR44 = EmptyISR);
PROVIDE(ISR45 = EmptyISR);
PROVIDE(ISR46 = EmptyISR);
PROVIDE(ISR47 = EmptyISR);
PROVIDE(ISR48 = EmptyISR);
PROVIDE(ISR49 = EmptyISR);
PROVIDE(ISR50 = EmptyISR);
PROVIDE(ISR51 = EmptyISR);
PROVIDE(ISR52 = EmptyISR);
PROVIDE(ISR53 = EmptyISR);
PROVIDE(ISR54 = EmptyISR);
PROVIDE(ISR55 = EmptyISR);
PROVIDE(ISR56 = EmptyISR);
PROVIDE(ISR57 = EmptyISR);
PROVIDE(ISR58 = EmptyISR);
PROVIDE(ISR59 = EmptyISR);
PROVIDE(ISR60 = EmptyISR);
PROVIDE(ISR61 = EmptyISR);
PROVIDE(ISR62 = EmptyISR);
PROVIDE(ISR63 = EmptyISR);
PROVIDE(ISR64 = EmptyISR);
PROVIDE(ISR65 = EmptyISR);
PROVIDE(ISR66 = EmptyISR);
PROVIDE(ISR67 = EmptyISR);
PROVIDE(ISR68 = EmptyISR);
PROVIDE(ISR69 = EmptyISR);
PROVIDE(ISR70 = EmptyISR);
PROVIDE(ISR71 = EmptyISR);
PROVIDE(ISR72 = EmptyISR);
PROVIDE(ISR73 = EmptyISR);
PROVIDE(ISR74 = EmptyISR);
PROVIDE(ISR75 = EmptyISR);
PROVIDE(ISR76 = EmptyISR);
PROVIDE(ISR77 = EmptyISR);
PROVIDE(ISR78 = EmptyISR);
PROVIDE(ISR79 = EmptyISR);
PROVIDE(ISR80 = EmptyISR);
PROVIDE(ISR81 = EmptyISR);
PROVIDE(ISR82 = EmptyISR);
PROVIDE(ISR83 = EmptyISR);
PROVIDE(ISR84 = EmptyISR);
PROVIDE(ISR85 = EmptyISR);
PROVIDE(ISR86 = EmptyISR);
PROVIDE(ISR87 = EmptyISR);
PROVIDE(ISR88 = EmptyISR);
PROVIDE(ISR89 = EmptyISR);
PROVIDE(ISR90 = EmptyISR);
PROVIDE(ISR91 = EmptyISR);
PROVIDE(ISR92 = EmptyISR);
PROVIDE(ISR93 = EmptyISR);
PROVIDE(ISR94 = EmptyISR);
PROVIDE(ISR95 = EmptyISR);
PROVIDE(ISR96 = EmptyISR);
PROVIDE(ISR97 = EmptyISR);
PROVIDE(ISR98 = EmptyISR);
PROVIDE(ISR99 = EmptyISR);
PROVIDE(ISR100 = EmptyISR);
PROVIDE(ISR101 = EmptyISR);
PROVIDE(ISR102 = EmptyISR);
PROVIDE(ISR103 = EmptyISR);
PROVIDE(ISR104 = EmptyISR);
PROVIDE(ISR105 = EmptyISR);
PROVIDE(ISR106 = EmptyISR);
PROVIDE(ISR107 = EmptyISR);
PROVIDE(ISR108 = EmptyISR);
PROVIDE(ISR109 = EmptyISR);
PROVIDE(ISR110 = EmptyISR);
PROVIDE(ISR111 = EmptyISR);
PROVIDE(ISR112 = EmptyISR);
PROVIDE(ISR113 = EmptyISR);
PROVIDE(ISR114 = EmptyISR);
PROVIDE(ISR115 = EmptyISR);
PROVIDE(ISR116 = EmptyISR);
PROVIDE(ISR117 = EmptyISR);
PROVIDE(ISR118 = EmptyISR);
PROVIDE(ISR119 = EmptyISR);
PROVIDE(ISR120 = EmptyISR);
PROVIDE(ISR121 = EmptyISR);
PROVIDE(ISR122 = EmptyISR);
PROVIDE(ISR123 = EmptyISR);
PROVIDE(ISR124 = EmptyISR);
PROVIDE(ISR125 = EmptyISR);
PROVIDE(ISR126 = EmptyISR);
PROVIDE(ISR127 = EmptyISR);
PROVIDE(ISR128 = EmptyISR);
PROVIDE(ISR129 = EmptyISR);
PROVIDE(ISR130 = EmptyISR);
PROVIDE(ISR131 = EmptyISR);
PROVIDE(ISR132 = EmptyISR);
PROVIDE(ISR133 = EmptyISR);
PROVIDE(ISR134 = EmptyISR);
PROVIDE(ISR135 = EmptyISR);
PROVIDE(ISR136 = EmptyISR);
PROVIDE(ISR137 = EmptyISR);
PROVIDE(ISR138 = EmptyISR);
PROVIDE(ISR139 = EmptyISR);
PROVIDE(ISR140 = EmptyISR);
PROVIDE(ISR141 = EmptyISR);
PROVIDE(ISR142 = EmptyISR);
PROVIDE(ISR143 = EmptyISR);
PROVIDE(ISR144 = EmptyISR);
PROVIDE(ISR145 = EmptyISR);
PROVIDE(ISR146 = EmptyISR);
PROVIDE(ISR147 = EmptyISR);
PROVIDE(ISR148 = EmptyISR);
PROVIDE(ISR149 = EmptyISR);
PROVIDE(ISR150 = EmptyISR);
PROVIDE(ISR151 = EmptyISR);
PROVIDE(ISR152 = EmptyISR);
PROVIDE(ISR153 = EmptyISR);
PROVIDE(ISR154 = EmptyISR);
PROVIDE(ISR155 = EmptyISR);
PROVIDE(ISR156 = EmptyISR);
PROVIDE(ISR157 = EmptyISR);
PROVIDE(ISR158 = EmptyISR);
PROVIDE(ISR159 = EmptyISR);
PROVIDE(ISR160 = EmptyISR);
PROVIDE(ISR161 = EmptyISR);
PROVIDE(ISR162 = EmptyISR);
PROVIDE(ISR163 = EmptyISR);
PROVIDE(ISR164 = EmptyISR);
PROVIDE(ISR165 = EmptyISR);
PROVIDE(ISR166 = EmptyISR);
PROVIDE(ISR167 = EmptyISR);
PROVIDE(ISR168 = EmptyISR);
PROVIDE(ISR169 = EmptyISR);
PROVIDE(ISR170 = EmptyISR);
PROVIDE(ISR171 = EmptyISR);
PROVIDE(ISR172 = EmptyISR);
PROVIDE(ISR173 = EmptyISR);
PROVIDE(ISR174 = EmptyISR);
PROVIDE(ISR175 = EmptyISR);
PROVIDE(ISR176 = EmptyISR);
PROVIDE(ISR177 = EmptyISR);
PROVIDE(ISR178 = EmptyISR);
PROVIDE(ISR179 = EmptyISR);
PROVIDE(ISR180 = EmptyISR);
PROVIDE(ISR181 = EmptyISR);
PROVIDE(ISR182 = EmptyISR);
PROVIDE(ISR183 = EmptyISR);
PROVIDE(ISR184 = EmptyISR);
PROVIDE(ISR185 = EmptyISR);
PROVIDE(ISR186 = EmptyISR);
PROVIDE(ISR187 = EmptyISR);
PROVIDE(ISR188 = EmptyISR);
PROVIDE(ISR189 = EmptyISR);
PROVIDE(ISR190 = EmptyISR);
PROVIDE(ISR191 = EmptyISR);
PROVIDE(ISR192 = EmptyISR);
PROVIDE(ISR193 = EmptyISR);
PROVIDE(ISR194 = EmptyISR);
PROVIDE(ISR195 = EmptyISR);
PROVIDE(ISR196 = EmptyISR);
PROVIDE(ISR197 = EmptyISR);
PROVIDE(ISR198 = EmptyISR);
PROVIDE(ISR199 = EmptyISR);
PROVIDE(ISR200 = EmptyISR);
PROVIDE(ISR201 = EmptyISR);
PROVIDE(ISR202 = EmptyISR);
PROVIDE(ISR203 = EmptyISR);
PROVIDE(ISR204 = EmptyISR);
PROVIDE(ISR205 = EmptyISR);
PROVIDE(ISR206 = EmptyISR);
PROVIDE(ISR207 = EmptyISR);
PROVIDE(ISR208 = EmptyISR);
PROVIDE(ISR209 = EmptyISR);
PROVIDE(ISR210 = EmptyISR);
PROVIDE(ISR211 = EmptyISR);
PROVIDE(ISR212 = EmptyISR);
PROVIDE(ISR213 = EmptyISR);
PROVIDE(ISR214 = EmptyISR);
PROVIDE(ISR215 = EmptyISR);
PROVIDE(ISR216 = EmptyISR);
PROVIDE(ISR217 = EmptyISR);
PROVIDE(ISR218 = EmptyISR);
PROVIDE(ISR219 = EmptyISR);
PROVIDE(ISR220 = EmptyISR);
PROVIDE(ISR221 = EmptyISR);
PROVIDE(ISR222 = EmptyISR);
PROVIDE(ISR223 = EmptyISR);
PROVIDE(ISR224 = EmptyISR);
PROVIDE(ISR225 = EmptyISR);
PROVIDE(ISR226 = EmptyISR);
PROVIDE(ISR227 = EmptyISR);
PROVIDE(ISR228 = EmptyISR);
PROVIDE(ISR229 = EmptyISR);
PROVIDE(ISR230 = EmptyISR);
PROVIDE(ISR231 = EmptyISR);
PROVIDE(ISR232 = EmptyISR);
PROVIDE(ISR233 = EmptyISR);
PROVIDE(ISR234 = EmptyISR);
PROVIDE(ISR235 = EmptyISR);
PROVIDE(ISR236 = EmptyISR);
PROVIDE(ISR237 = EmptyISR);
PROVIDE(ISR238 = EmptyISR);
PROVIDE(ISR239 = EmptyISR);